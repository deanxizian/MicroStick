## firmware/sticks3/main/Kconfig.projbuild
```kconfig
menu "MicroStick Micro"

config MICROSTICK_MICRO_STATUS_DIAGNOSTICS
    bool "Log raw v.oai.thstatus payloads to the serial console"
    default n
    help
        Logs only the Micro Agent-light status RPC used to build verified UI
        fixtures. It never logs prompts, responses, focused-app payloads, or
        Codex session contents. Disable it for normal release builds.

endmenu
```

## firmware/sticks3/sdkconfig.defaults
```kconfig
CONFIG_IDF_TARGET="esp32s3"
CONFIG_IDF_TARGET_ESP32S3=y
CONFIG_BT_ENABLED=y
CONFIG_BT_BLUEDROID_ENABLED=y
CONFIG_BT_BLE_ENABLED=y
CONFIG_BT_BLE_42_FEATURES_SUPPORTED=y
CONFIG_ESPTOOLPY_FLASHSIZE_8MB=y
CONFIG_ESP_DEFAULT_CPU_FREQ_MHZ_240=y
CONFIG_FREERTOS_HZ=1000
CONFIG_LOG_DEFAULT_LEVEL_INFO=y
CONFIG_LV_CONF_SKIP=y
CONFIG_LV_COLOR_DEPTH_16=y
CONFIG_LV_FONT_MONTSERRAT_10=y
CONFIG_LV_FONT_MONTSERRAT_12=y
CONFIG_LV_FONT_MONTSERRAT_14=y
CONFIG_LV_FONT_MONTSERRAT_16=y
CONFIG_LV_FONT_MONTSERRAT_20=y
# CONFIG_LV_FONT_SIMSUN_14_CJK is not set
# CONFIG_LV_BUILD_EXAMPLES is not set

CONFIG_SPIRAM=y
CONFIG_SPIRAM_MODE_OCT=y
CONFIG_SPIRAM_SPEED_80M=y
CONFIG_SPIRAM_USE_MALLOC=y

CONFIG_PARTITION_TABLE_CUSTOM=y
CONFIG_PARTITION_TABLE_CUSTOM_FILENAME="partitions_sticks3.csv"
CONFIG_PARTITION_TABLE_FILENAME="partitions_sticks3.csv"

# Native microphone-only USB UAC 2.0 device for macOS.
CONFIG_UAC_SPEAKER_CHANNEL_NUM=0
CONFIG_UAC_MIC_CHANNEL_NUM=1
CONFIG_UAC_SAMPLE_RATE=48000
CONFIG_UAC_BIT_RESOLUTION_16=y
CONFIG_UAC_MIC_INTERVAL_MS=10
CONFIG_UAC_SUPPORT_MACOS=y
CONFIG_UAC_TUSB_VID=0x303A
CONFIG_UAC_TUSB_PID=0x8361
CONFIG_UAC_TUSB_MANUFACTURER="MicroStick"
CONFIG_UAC_TUSB_PRODUCT="MicroStick Microphone"
CONFIG_UAC_TUSB_SERIAL_NUM="MICROSTICKMIC01"
```
